/**
 * @cliArgs --board "/ti/boards/LP_MSPM0G3507" --product "mspm0_sdk@2.01.00.03"
 * @versions {"tool":"1.20.0+3587"}
 */

/**
 * Import the modules used in this configuration.
 */
const GPIO          = scripting.addModule("/ti/driverlib/GPIO", {}, false);
const GPIO1         = GPIO.addInstance();
const GPIO2         = GPIO.addInstance();
const PWM           = scripting.addModule("/ti/driverlib/PWM", {}, false);
const PWM1          = PWM.addInstance();
const SYSCTL        = scripting.addModule("/ti/driverlib/SYSCTL");
const TIMER         = scripting.addModule("/ti/driverlib/TIMER", {}, false);
const TIMER1        = TIMER.addInstance();
const UART          = scripting.addModule("/ti/driverlib/UART", {}, false);
const UART1         = UART.addInstance();
const UART2         = UART.addInstance();
const ProjectConfig = scripting.addModule("/ti/project_config/ProjectConfig");

/**
 * Write custom configuration values to the imported modules.
 */
const divider7       = system.clockTree["PLL_PDIV"];
divider7.divideValue = 2;

const divider9       = system.clockTree["UDIV"];
divider9.divideValue = 2;

const multiplier2         = system.clockTree["PLL_QDIV"];
multiplier2.multiplyValue = 5;

const mux8       = system.clockTree["HSCLKMUX"];
mux8.inputSelect = "HSCLKMUX_SYSPLL2X";

GPIO1.$name                         = "GPIO_DIR";
GPIO1.associatedPins.create(2);
GPIO1.associatedPins[0].$name       = "PIN_0";
GPIO1.associatedPins[0].pin.$assign = "boosterpack.35";
GPIO1.associatedPins[1].$name       = "PIN_1";
GPIO1.associatedPins[1].pin.$assign = "boosterpack.36";

const Board                       = scripting.addModule("/ti/driverlib/Board", {}, false);
Board.peripheral.$assign          = "DEBUGSS";
Board.peripheral.swclkPin.$assign = "j25_expansion.16";
Board.peripheral.swdioPin.$assign = "j25_expansion.14";

GPIO2.$name                              = "GPIO_KEY";
GPIO2.associatedPins[0].direction        = "INPUT";
GPIO2.associatedPins[0].assignedPort     = "PORTB";
GPIO2.associatedPins[0].assignedPin      = "21";
GPIO2.associatedPins[0].interruptEn      = true;
GPIO2.associatedPins[0].internalResistor = "PULL_UP";
GPIO2.associatedPins[0].polarity         = "FALL";
GPIO2.associatedPins[0].$name            = "PIN";

PWM1.interrupts                         = ["ZERO_EVENT"];
PWM1.$name                              = "PWM_1";
PWM1.clockPrescale                      = 256;
PWM1.timerCount                         = 50;
PWM1.peripheral.$assign                 = "TIMA0";
PWM1.peripheral.ccp0Pin.$assign         = "boosterpack.4";
PWM1.peripheral.ccp1Pin.$assign         = "boosterpack.3";
PWM1.PWM_CHANNEL_0.$name                = "ti_driverlib_pwm_PWMTimerCC0";
PWM1.PWM_CHANNEL_1.$name                = "ti_driverlib_pwm_PWMTimerCC1";
PWM1.ccp0PinConfig.$name                = "ti_driverlib_gpio_GPIOPinGeneric0";
PWM1.ccp0PinConfig.direction            = scripting.forceWrite("OUTPUT");
PWM1.ccp0PinConfig.hideOutputInversion  = scripting.forceWrite(false);
PWM1.ccp0PinConfig.onlyInternalResistor = scripting.forceWrite(false);
PWM1.ccp0PinConfig.passedPeripheralType = scripting.forceWrite("Digital");
PWM1.ccp1PinConfig.direction            = scripting.forceWrite("OUTPUT");
PWM1.ccp1PinConfig.hideOutputInversion  = scripting.forceWrite(false);
PWM1.ccp1PinConfig.onlyInternalResistor = scripting.forceWrite(false);
PWM1.ccp1PinConfig.passedPeripheralType = scripting.forceWrite("Digital");
PWM1.ccp1PinConfig.$name                = "ti_driverlib_gpio_GPIOPinGeneric2";

SYSCTL.forceDefaultClkConfig = true;
SYSCTL.VDD                   = 5;
SYSCTL.peripheral.$assign    = "SYSCTL";

TIMER1.$name            = "TIMER_0";
TIMER1.timerClkPrescale = 100;
TIMER1.timerStartTimer  = true;
TIMER1.timerMode        = "PERIODIC";
TIMER1.interrupts       = ["ZERO"];
TIMER1.timerPeriod      = "20 ms";

UART1.$name                             = "UART_WIT";
UART1.direction                         = "RX";
UART1.rxTimeoutValue                    = 1;
UART1.enabledInterrupts                 = ["RX_TIMEOUT_ERROR"];
UART1.enabledDMARXTriggers              = "DL_UART_DMA_INTERRUPT_RX";
UART1.enableFIFO                        = true;
UART1.interruptPriority                 = "1";
UART1.targetBaudRate                    = 921600;
UART1.peripheral.$assign                = "UART0";
UART1.peripheral.rxPin.$assign          = "boosterpack.39";
UART1.rxPinConfig.hideOutputInversion   = scripting.forceWrite(false);
UART1.rxPinConfig.onlyInternalResistor  = scripting.forceWrite(false);
UART1.rxPinConfig.passedPeripheralType  = scripting.forceWrite("Digital");
UART1.rxPinConfig.$name                 = "ti_driverlib_gpio_GPIOPinGeneric1";
UART1.DMA_CHANNEL_RX.$name              = "DMA_WIT";
UART1.DMA_CHANNEL_RX.srcLength          = "BYTE";
UART1.DMA_CHANNEL_RX.dstLength          = "BYTE";
UART1.DMA_CHANNEL_RX.addressMode        = "f2b";
UART1.DMA_CHANNEL_RX.destIncrement      = "INCREMENT";
UART1.DMA_CHANNEL_RX.peripheral.$assign = "DMA_CH0";

UART2.$name                            = "UART_MAIX";
UART2.targetBaudRate                   = 115200;
UART2.direction                        = "RX";
UART2.enableFIFO                       = true;
UART2.rxTimeoutValue                   = 1;
UART2.enabledInterrupts                = ["RX_TIMEOUT_ERROR"];
UART2.enabledDMARXTriggers             = "DL_UART_DMA_INTERRUPT_RX";
UART2.rxFifoThreshold                  = "DL_UART_RX_FIFO_LEVEL_3_4_FULL";
UART2.peripheral.rxPin.$assign         = "boosterpack.26";
UART2.rxPinConfig.hideOutputInversion  = scripting.forceWrite(false);
UART2.rxPinConfig.onlyInternalResistor = scripting.forceWrite(false);
UART2.rxPinConfig.passedPeripheralType = scripting.forceWrite("Digital");
UART2.rxPinConfig.$name                = "ti_driverlib_gpio_GPIOPinGeneric4";
UART2.DMA_CHANNEL_RX.$name             = "DMA_MAIX";
UART2.DMA_CHANNEL_RX.srcLength         = "BYTE";
UART2.DMA_CHANNEL_RX.dstLength         = "BYTE";
UART2.DMA_CHANNEL_RX.addressMode       = "f2b";

ProjectConfig.deviceSpin = "MSPM0G3507";

/**
 * Pinmux solution for unlocked pins/peripherals. This ensures that minor changes to the automatic solver in a future
 * version of the tool will not impact the pinmux you originally saw.  These lines can be completely deleted in order to
 * re-solve from scratch.
 */
GPIO2.associatedPins[0].pin.$suggestSolution     = "j19_expansion.4";
TIMER1.peripheral.$suggestSolution               = "TIMA1";
UART2.peripheral.$suggestSolution                = "UART1";
UART2.DMA_CHANNEL_RX.peripheral.$suggestSolution = "DMA_CH1";
